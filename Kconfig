## boards/shields/tps65_xiao/Kconfig.defconfig
```kconfig
if SHIELD_TPS65_XIAO

config ZMK_KEYBOARD_NAME
    default "TPS65 Pad"

config ZMK_POINTING
    default y

endif
```

## config/west.yml
```yaml
manifest:
  remotes:
    - name: moergo-sc
      url-base: https://github.com/moergo-sc
    - name: darknao
      url-base: https://github.com/darknao
    - name: qnlbnsl
      url-base: https://github.com/qnlbnsl

  projects:
    - name: zmk
      remote: qnlbnsl
      revision: zephyr-4.1
      import: app/west.yml

    # Upstream's 4.1 branch (feat/new-status-screens) plus our "glove80" layout.
    - name: prospector-zmk-module
      remote: qnlbnsl
      revision: zephyr-4.1

  self:
    path: config
```

## drivers/input/Kconfig
```kconfig
config INPUT_IQS5XX
    bool "Azoteq IQS5xx trackpad controller"
    default y
    depends on DT_HAS_AZOTEQ_IQS5XX_ENABLED
    select I2C
    select GPIO
    select INPUT
```

## dts/bindings/input/azoteq,iqs5xx.yaml
```yaml
description: |
  Azoteq IQS5xx-B000 trackpad controller (IQS550 / IQS572 / IQS525), as used on the
  TPS43 and TPS65 trackpad modules. Reports cursor movement, scroll, clicks (1/2/3-finger
  tap) and 3-finger swipes / pinch zoom as input events.

  Events: INPUT_REL_X/Y (cursor), INPUT_REL_WHEEL/HWHEEL (scroll), INPUT_BTN_0/1/2
  (left/right/middle click), INPUT_KEY_LEFT/RIGHT/UP/DOWN (3-finger swipe, press+release),
  INPUT_KEY_KPPLUS/KPMINUS (pinch zoom in/out steps). Map the key codes to behaviors with a
  zmk,input-processor-behaviors processor.

compatible: "azoteq,iqs5xx"

include: i2c-device.yaml

properties:
  rdy-gpios:
    type: phandle-array
    description: |
      RDY output of the controller (active high). Optional: without it the driver polls every
      report-rate-ms and the controller holds the I2C clock until its comms window opens.
  reset-gpios:
    type: phandle-array
    description: Optional NRST line (use GPIO_ACTIVE_LOW).
  report-rate-ms:
    type: int
    default: 10
    description: Report interval in active and idle-touch modes.
  event-mode:
    type: boolean
    description: |
      Only signal RDY on touch / gesture changes (saves power) instead of every cycle.
      Ignored without rdy-gpios.
  flip-x:
    type: boolean
  flip-y:
    type: boolean
  swap-xy:
    type: boolean
  palm-reject:
    type: boolean
  hold-to-drag:
    type: boolean
    description: Holding one finger still (controller hold time) presses the left button until lift.
  natural-scroll:
    type: boolean
    description: Invert the scroll direction.
  scroll-divisor:
    type: int
    default: 16
    description: Controller scroll units per wheel step.
  zoom-divisor:
    type: int
    default: 64
    description: Controller zoom units per zoom key step.
  swipe-distance:
    type: int
    default: 300
    description: 3-finger movement (controller units) that triggers a swipe.
  three-finger-tap-ms:
    type: int
    default: 250
    description: Longest 3-finger contact that still counts as a middle-click tap.
```

## src/ptp/Kconfig
```kconfig
# Precision touchpad (PTP) support. See include/ptp.h.

config PTP
    bool
    help
      Set when this build has a touchpad frame transport; the trackpad driver then hands over
      finger frames whenever ptp_active() says the host wants them.

config PTP_USB
    bool "Precision touchpad over USB (one extra HID interface per pad)"
    depends on USB_DEVICE_HID && ZMK_USB
    select PTP
    help
      Adds a Windows Precision Touchpad HID interface per pad (HID_1, HID_2, ...). Hosts that
      switch it into touchpad mode (Windows, Linux hid-multitouch) get raw finger frames and do
      gestures themselves; others (macOS) keep mouse mode. Needs
      USB_HID_DEVICE_COUNT = PTP_USB_PADS + 1 and HID_INTERRUPT_EP_MPS >= 30.

config PTP_SPLIT_PERIPHERAL
    bool "Send touchpad frames to the split central over BLE"
    depends on ZMK_SPLIT_BLE && !ZMK_SPLIT_ROLE_CENTRAL
    select PTP

config PTP_SPLIT_CENTRAL
    bool "Forward touchpad frames from split peripherals to USB"
    depends on PTP_USB && ZMK_SPLIT_BLE && ZMK_SPLIT_ROLE_CENTRAL

config PTP_SPLIT_LEFT_HELPER
    bool "Left trackpad is a helper for the right one (gestures, no cursor)"
    depends on PTP_SPLIT_CENTRAL
    default y
    select ZMK_POINTING
    imply ZMK_POINTING_SMOOTH_SCROLLING
    help
      The left pad's frames don't go to the host; they become mouse buttons and scrolling for
      the right pad (resting finger = held button, tap = click, double tap = drag lock,
      circling = scroll). The right pad then uses the first USB touchpad, so
      PTP_USB_PADS can be 1. See docs/trackpads-and-screen.md.

if PTP

choice PTP_SPLIT_PAD_SIDE
    prompt "Which side this trackpad is on"
    depends on PTP_SPLIT_PERIPHERAL
    default PTP_SPLIT_PAD_SIDE_LEFT
    help
      Told to the central, which gives the left pad the first USB touchpad and the right pad
      the second, whatever order they connect in, and uses it for cross-pad gestures.

config PTP_SPLIT_PAD_SIDE_LEFT
    bool "Left"

config PTP_SPLIT_PAD_SIDE_RIGHT
    bool "Right"

endchoice

config PTP_SPLIT_JITTER_US
    int "Jitter buffer delay for split pads (us)"
    depends on PTP_SPLIT_CENTRAL
    default 10000
    help
      Frames from a split pad are released to USB this long after the pad read them, on the
      pad's own timing, which hides BLE connection-event bunching. 0 = send on arrival.

config PTP_SPLIT_PAD_APPEARANCE
    int "GAP appearance that marks a split peripheral as a trackpad"
    default 965
    help
      Trackpad peripherals set CONFIG_BT_DEVICE_APPEARANCE to this (965 = digitizer tablet;
      keyboard halves keep 961). The central reads it to tell pads from halves without a
      GATT request that can fail: the Zephyr 3.5 (zmk-fixes) ATT client never completes a
      request that gets an error response.

config PTP_USB_PADS
    int "Number of USB touchpad interfaces"
    depends on PTP_USB
    range 1 2
    default 1

config PTP_LOGICAL_X
    int "Logical X range"
    range 1 4095
    default 4095

config PTP_LOGICAL_Y
    int "Logical Y range"
    range 1 4095
    default 4095

config PTP_PHYSICAL_X
    int "Pad width in 0.1 mm"
    default 650

config PTP_PHYSICAL_Y
    int "Pad height in 0.1 mm"
    default 490

config PTP_USB_INIT_PRIORITY
    int "USB touchpad init priority (must run before ZMK_USB_INIT_PRIORITY)"
    depends on PTP_USB
    default 90

module = PTP
module-str = ptp
source "subsys/logging/Kconfig.template.log_config"

endif
```
