/* Peripherals don't use a keymap; the dongle's keymap is the one that applies. */
#include <behaviors.dtsi>

/ {
    keymap {
        compatible = "zmk,keymap";
        default_layer {
            bindings = <&none>;
        };
    };
};
